## boards/shields/flippie/Kconfig.shield
```kconfig
config SHIELD_FLIPPIE_LEFT
    def_bool $(shields_list_contains,flippie_left)

config SHIELD_FLIPPIE_RIGHT
    def_bool $(shields_list_contains,flippie_right)
```
